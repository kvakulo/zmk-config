## config/west.yml
```yaml
manifest:
  remotes:
    - name: zmkfirmware
      url-base: https://github.com/zmkfirmware
  projects:
    - name: zmk
      remote: zmkfirmware
      revision: aa3e5dd70fdd1b364fa9ad26f14425be613d180c
      import: app/west.yml
  self:
    path: config
```
